## boards/shields/hamdactyl/Kconfig.defconfig
```kconfig
if SHIELD_HAMDACTYL_DONGLE

# Name must be less than 16 characters long!
config ZMK_KEYBOARD_NAME
    default "HamDactyl"

config ZMK_SPLIT_ROLE_CENTRAL
    default y

config ZMK_SPLIT_BLE_CENTRAL_PERIPHERALS
  default 2

config BT_MAX_CONN
  default 7

config BT_MAX_PAIRED
  default 7

endif

if SHIELD_HAMDACTYL_DONGLE || SHIELD_HAMDACTYL_RIGHT || SHIELD_HAMDACTYL_LEFT

config ZMK_SPLIT
    default y

endif

# ---------------------
# Kconfig for shield "hamdactyl_dongle"
# ---------------------
if SHIELD_HAMDACTYL_DONGLE

config I2C
    default y

config ZMK_DISPLAY
    default y

if ZMK_DISPLAY

config I2C
    default y

config SH1106
    default y

endif # ZMK_DISPLAY

if LVGL

config LV_Z_VDB_SIZE
    default 64

config LV_DPI_DEF
    default 148

config LV_Z_BITS_PER_PIXEL
    default 1

choice LV_COLOR_DEPTH
    default LV_COLOR_DEPTH_1
endchoice

endif # LVGL

endif
```

## boards/shields/hamdactyl/Kconfig.shield
```kconfig
config SHIELD_HAMDACTYL_DONGLE
    def_bool $(shields_list_contains,hamdactyl_dongle)
  
config SHIELD_HAMDACTYL_RIGHT
    def_bool $(shields_list_contains,hamdactyl_right)
  
config SHIELD_HAMDACTYL_LEFT
    def_bool $(shields_list_contains,hamdactyl_left)
  
```

## config/west.yml
```yaml
manifest:
  defaults:
    revision: v0.3.0
  remotes:
    - name: zmkfirmware
      url-base: https://github.com/zmkfirmware
    - name: englmaxi
      url-base: https://github.com/englmaxi
    # Additional modules containing boards/shields/custom code can be listed here as well
    # See https://docs.zephyrproject.org/3.2.0/develop/west/manifest.html#projects
  projects:
    - name: zmk
      remote: zmkfirmware
      import: app/west.yml
    
    - name: zmk-dongle-display
      remote: englmaxi
      revision: v0.3  # use 'v0.3' instead of 'main' if you use have pinned zmk to 'v0.3' or below
  self:
    path: config
```
